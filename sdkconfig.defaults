## sdkconfig.defaults
```kconfig
# ESP32-C5  –  5 GHz SoftAP + BLE NUS UART
# ESP32-C5 is BLE-only (Bluetooth LE Core 6.0, no BR/EDR Classic BT)
CONFIG_IDF_TARGET="esp32c5"
CONFIG_ESPTOOLPY_FLASHSIZE_16MB=y
CONFIG_PARTITION_TABLE_CUSTOM=y
CONFIG_SPIRAM=y

# BLE stack – Bluedroid host, BLE controller
CONFIG_BT_ENABLED=y
CONFIG_BT_BLUEDROID_ENABLED=y
CONFIG_BT_CONTROLLER_ENABLED=y
CONFIG_BT_BLE_ENABLED=y
CONFIG_BT_BLE_42_FEATURES_SUPPORTED=y
CONFIG_BT_BLE_50_FEATURES_SUPPORTED=y

# Disable Classic BT (not supported on ESP32-C5 hardware)
CONFIG_BT_CLASSIC_ENABLED=n
```
